GPIO_PORTB_DATA		EQU		0X400053FC	;DATA ADDRESS TO ALL PINS
GPIO_PORTB_DIR		EQU		0X40005400
GPIO_PORTB_AFSEL	EQU		0X40005420
GPIO_PORTB_DEN		EQU		0X4000551C
GPIO_PORTB_PUR		EQU		0X40005510
PUB					EQU		0XF0		;INPUT IS PULLED UP
IOB					EQU		0X0F		;7-4 INPUT
IOF					EQU		0X06
PDF					EQU		0X06

SYSCTL_RCGCGPIO		EQU		0X400FE608
GPIO_PORTF_DATA		EQU		0x40025018	;PIN1 AND 2
GPIO_PORTF_DIR		EQU		0X40025400
GPIO_PORTF_AFSEL	EQU		0X40025420
GPIO_PORTF_DEN		EQU		0X4002551C
GPIO_PORTF_PDR		EQU		0X40025514	;PULLDOWN
;GPIO_PORTF_LOCK		EQU		0x40025520
	
					AREA	subroutine, READONLY, CODE, ALIGN=2
					THUMB
					EXPORT	Start
						
Start				LDR		R1,=SYSCTL_RCGCGPIO
					LDR		R0,[R1]
					ORR		R0,R0,#0X22	;0010_0010 B AND F
					STR		R0,[R1]
					NOP
					NOP
					NOP								;LET GPIO CLOCK STABILIZE
						
					LDR		R0,=GPIO_PORTB_PUR		;INPUT IS PULLED UP
					MOV		R1,#PUB
					STR		R1,[R0]
					
					LDR		R1,=GPIO_PORTB_DIR		; CONFIG. OF PORT B STARTS
					LDR		R0,[R1]
					BIC		R0,#0XFF
					ORR		R0,#IOB
					STR		R0,[R1]
					LDR		R1,=GPIO_PORTB_AFSEL
					LDR		R0,[R1]
					BIC		R0,#0XFF
					STR		R0,[R1]
					LDR		R1,=GPIO_PORTB_DEN
					LDR		R0,[R1]
					ORR		R0,#0XFF
					STR		R0,[R1]					;CONFIG. OF PORT B ENDS
					
					LDR		R0,=GPIO_PORTF_PDR		;INPUT IS PULLED UP
					MOV		R1,#PDF
					STR		R1,[R0]
					
					
					
					LDR		R1,=GPIO_PORTF_DIR		; CONFIG. OF PORT F STARTS
					LDR		R0,[R1]
					BIC		R0,#0XFF
					ORR		R0,#IOF
					STR		R0,[R1]
					LDR		R1,=GPIO_PORTF_AFSEL
					LDR		R0,[R1]
					BIC		R0,#0XFF
					STR		R0,[R1]
					LDR		R1,=GPIO_PORTF_DEN
					LDR		R0,[R1]
					ORR		R0,#0XFF
					STR		R0,[R1]					;CONFIG. OF PORT F ENDS					
					


					BX		LR
					ALIGN
					END