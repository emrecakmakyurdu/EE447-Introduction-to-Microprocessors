;;;;;;;;;;;;;;;;;;;;;;;;;;;;;;;;;;;;;;;;;;;;;;;;;;;
;				  MAIN OF THE Q2				  ;
;;;;;;;;;;;;;;;;;;;;;;;;;;;;;;;;;;;;;;;;;;;;;;;;;;;

		AREA	main,	READONLY,	CODE
		THUMB
		EXTERN	Start
		EXTERN	DELAY100
		EXTERN	DELAY5SEC
		EXPORT	__main
			
GPIO_PORTB_DATA		EQU		0X400053FC	;DATA ADDRESS TO ALL PINS
;GPIO_PORTB_DIR		EQU		0X40005400
;GPIO_PORTB_AFSEL	EQU		0X40005420
;GPIO_PORTB_DEN		EQU		0X4000551C
;GPIO_PORTB_PUR		EQU		0X40005510
;PUB					EQU		0XF0
;IOB					EQU		0XF0		;FIRST FOUR IS INPUT
;GPIO_PORTE_DATA		EQU		0X400243FC	;DATA ADDRESS TO ALL PINS
;GPIO_PORTE_DIR		EQU		0X40024400
;GPIO_PORTE_AFSEL	EQU		0X40024420
;GPIO_PORTE_DEN		EQU		0X4002451C
;IOE					EQU		0X00		;EVERY BIT IS INPUT
;SYSCTL_RCGCGPIO		EQU		0X400FE608

;CONNECTION IS: S1=B0,S2=B1,S3=B2,S4=B3,D2=B4,D4=B5,D6=B6,D8=B7

__main
		BL Start
INPUT 	LDR 	R0,=GPIO_PORTB_DATA
loop 	LDRB 	R1,[R0]				;LOAD THE DATA
		BL 		DELAY100			;DEBOUNCING
		LDRB 	R2,[R0]				;DEBOUNCING
		CMP 	R1,R2				;DEBOUNCING
		BNE 	loop
		CMP		R1,#0XFF			;IF ANY OF THE KEYS IS NOT PRESSED, GO BACK
		BEQ		INPUT
		LSL 	R2,#4				;SHIFT THE INPUT 4 BITS TO LEFT IN ORDER TO WRITE IT TO OUTPUT PINS
		;LDR 	R0,=GPIO_PORTB_DATA	
		LDR 	R1,=0X400053C0		;OUTPUT PINS
		;AND 	R1,R0,R1			;CORRESPONDING PIN WILL BE 0, CORRESPONDING LED WILL BE ON
		STRB 	R2,[R1]
		BL 		DELAY5SEC			;WAIT 5 SEC
		LDR 	R1,=0X400053C0
		MOV		R2,#0XFF			;REASSIGN OUTPUT PINS TO 0
		STRB	R2,[R1]
		B 		INPUT
LOOP	B 		LOOP
		ALIGN
		END