GPIO_PORTB_DATA		EQU		0X400053FC	;DATA ADDRESS TO ALL PINS
GPIO_PORTB_DIR		EQU		0X40005400
GPIO_PORTB_AFSEL	EQU		0X40005420
GPIO_PORTB_DEN		EQU		0X4000551C
GPIO_PORTB_PUR		EQU		0X40005510
PUB					EQU		0XF0		;1111_0000 FIRST FOUR BITS ARE PULLED UP WHICH ARE OUTPUT
;;;;;;;;;;;;;;;;;;;;;;;;;;;;;;;;;;;;;;;;;;;;;;;;;;;
;				  START OF Q2					  ;
;;;;;;;;;;;;;;;;;;;;;;;;;;;;;;;;;;;;;;;;;;;;;;;;;;;

IOB					EQU		0XF0		;3-0 INPUT, 7-4 OUTPUT
GPIO_PORTE_DATA		EQU		0X400243FC	;DATA ADDRESS TO ALL PINS
GPIO_PORTE_DIR		EQU		0X40024400
GPIO_PORTE_AFSEL	EQU		0X40024420
GPIO_PORTE_DEN		EQU		0X4002451C
IOE					EQU		0X00		;EVERY BIT IS INPUT
SYSCTL_RCGCGPIO		EQU		0X400FE608
	
					AREA	subroutine, READONLY, CODE, ALIGN=2
					THUMB
					EXPORT	Start
						
Start				LDR		R1,=SYSCTL_RCGCGPIO
					LDR		R0,[R1]
					ORR		R0,R0,#0X12 ;0000_0001_0010 PORTB AND PORTE
					STR		R0,[R1]
					NOP
					NOP
					NOP								;LET GPIO CLOCK STABILIZE
						
					LDR		R0,=GPIO_PORTB_PUR		;SINCE LEDS WILL BE ON WHEN OUTPUT IS 0, WE ARE PULLING UP OUTPUT PINS
					MOV		R1,#PUB
					STR		R1,[R0]
					
					LDR		R1,=GPIO_PORTB_DIR		; CONFIG. OF PORT B STARTS
					LDR		R0,[R1]
					BIC		R0,#0XFF				;0LANSIN
					ORR		R0,#IOB					;INPUT LOW, OUTPUT HIGH
					STR		R0,[R1]
					LDR		R1,=GPIO_PORTB_AFSEL
					LDR		R0,[R1]
					BIC		R0,#0XFF				;ALTERNATE FUNCTION KULLANMAYACAGIMIZ ICIN HEPSI 0LANDI
					STR		R0,[R1]
					LDR		R1,=GPIO_PORTB_DEN
					LDR		R0,[R1]
					ORR		R0,#0XFF				;TUM PINLER DIGITAL OLACAGI ICIN HEPSI 1LENDI
					STR		R0,[R1]					;CONFIG. OF PORT B ENDS
					
					LDR		R1,=GPIO_PORTE_DIR	; CONFIG. OF PORT E STARTS
					LDR		R0,[R1]
					ORR		R0,#IOE
					STR		R0,[R1]
					LDR		R1,=GPIO_PORTE_AFSEL
					LDR		R0,[R1]
					BIC		R0,#0XFF
					STR		R0,[R1]
					LDR		R1,=GPIO_PORTB_DEN
					LDR		R0,[R1]
					ORR		R0,#0XFF
					STR		R0,[R1]					;CONFIG. OF PORT E ENDS

					BX		LR
					ALIGN
					END