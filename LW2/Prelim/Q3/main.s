;;;;;;;;;;;;;;;;;;;;;;;;;;;;;;;;;;;;;;;;;;;;;;;;;;;
;				  MAIN OF THE Q3				  ;
;;;;;;;;;;;;;;;;;;;;;;;;;;;;;;;;;;;;;;;;;;;;;;;;;;;

		AREA	main,	READONLY,	CODE
		THUMB
		EXTERN	Start
		EXTERN	DELAY100
		EXTERN	OutChar
		EXTERN 	littledelay
		EXPORT	__main

;7-4 INPUT, 3-0 OUTPUT
;INPUT IS PULLED UP
;CONNECTION IS: L1=B0,L2=B1,L3=B2,L4=B3,R1=B4,R2=B5,R3=B6,R4=B7


GPIO_PORTB_DATA		EQU		0X40005000	;DATA ADDRESS TO ALL PINS
	
__main
			BL		Start
			
INPUT		LDR		R0,=GPIO_PORTB_DATA				;PORTB_DATA REGISTERININ ADRESINI R0'YA KAYDEDIYORUM
			LDRB	R1,[R0,#0X3FC]					;PORTB_DATA REGISTERINDEKI DEGERI R1'E KAYDEDIYORUM
			BL		DELAY100						;100MSEC BEKLIYORUM
			LDRB	R2,[R0,#0X3FC]					;PORTB_DATA REGISTERINDEKI DEGERI R2'YE KAYDEDIYORUM
			CMP		R1,R2							;DEBOUNCING ICIN KARSILASTIRMA YAPIYORUM
			BNE		INPUT							;DEGILSE YANLISLIK OLMUS, TEKRAR INPUT ALIYORUM
			CMP		R1,#0XF0						;R1 VE R2 AYNI OLMASINA RAGMEN 0XF0 ISELER, HICBIR TUSA BASILMAMIS DEMEKTIR, TEKRAR INPUT ALIYORUM
			BEQ		INPUT
			CPY		R5,R1							;BURAYA SAKLANAN DEGER E,D,B,7'DEN BIRI. SIRAYLA 1,2,3,4. COLUMNA DENK GELIYOR
			MOV		R6,#00							;R6'DA SAKLANACAK OLAN DEGER ILE HANGI ROW OLDUGUNU OGRENECEZ
			MOV		R2,#01							;R2'YI OUTPUTLARI SIRAYLA 0001, 0010, 0100, 1000 YAPMAK ICIN KULLANIYORUM
LOOP		STR		R2,[R0,#0X03C]					;OUTPUTA R2 DEGERI YAZILINCA INPUT DEGISIYOR
			BL		littledelay						;OUTPUTA YAZILAN DEGERIN ULASMASINI BEKLIYORUM
			LDRB	R3,[R0,#0X3C0]					;INPUTUN NE OLDUGUNU KAYDEDIYORUM
			ADD		R6,#1							;1=1.ROW, 2=2.ROW, 3=3.ROW, 4=4.ROW
			LSL		R2,#1							;R2'YI KAYDIRIYORUM
			CMP		R3,#0XF0						;EGER INPUTUM F ISE, O ROWDAKI TUSA BASMISIM DEMEKTIR
			BNE		LOOP
						
			
			;R5 BENIM COLUMN BELIRLEYENIM, R6 BENIM ROW BELIRLEYENIM
			CMP		R5,#0XE0						;1. COLUMN
			BEQ		COL1
			CMP		R5,#0XD0						;2. COLUMN
			BEQ		COL2
			CMP		R5,#0XB0						;3. COLUMN
			BEQ		COL3
			CMP		R5,#0X70						;4. COLUMN
			BEQ		COL4

COL1		CMP		R6,#1							;R6=1 ISE 1. COLUMN 1. ROW, 0. TUS
			MOVEQ	R0,#0
			CMP		R6,#2							;R6=2 ISE 1. COLUMN 2. ROW, 4. TUS
			MOVEQ	R0,#4
			CMP		R6,#3							;R6=3 ISE 1. COLUMN 3. ROW, 8. TUS
			MOVEQ	R0,#8	
			CMP		R6,#4							;R6=4 ISE 1. COLUMN 4. ROW, 12. TUS
			MOVEQ	R0,#12
			B		FINISH
			
			
COL2		CMP		R6,#1							;R6=1 ISE 2. COLUMN 1. ROW, 1. TUS
			MOVEQ	R0,#1
			CMP		R6,#2							;R6=2 ISE 2. COLUMN 2. ROW, 5. TUS
			MOVEQ	R0,#5
			CMP		R6,#3							;R6=3 ISE 2. COLUMN 3. ROW, 9. TUS
			MOVEQ	R0,#9
			CMP		R6,#4							;R6=4 ISE 2. COLUMN 4. ROW, 13. TUS
			MOVEQ	R0,#13
			B		FINISH


COL3		CMP		R6,#1							;R6=1 ISE 3. COLUMN 1. ROW, 2. TUS
			MOVEQ	R0,#2
			CMP		R6,#2							;R6=2 ISE 3. COLUMN 2. ROW, 6. TUS
			MOVEQ	R0,#6
			CMP		R6,#3							;R6=3 ISE 3. COLUMN 3. ROW, 10. TUS
			MOVEQ	R0,#10
			CMP		R6,#4							;R6=4 ISE 3. COLUMN 4. ROW, 14. TUS
			MOVEQ	R0,#14
			B		FINISH


COL4		CMP		R6,#1							;R6=1 ISE 4. COLUMN 1. ROW, 3. TUS
			MOVEQ	R0,#3
			CMP		R6,#2							;R6=2 ISE 4. COLUMN 2. ROW, 7. TUS
			MOVEQ	R0,#7
			CMP		R6,#3							;R6=3 ISE 4. COLUMN 3. ROW, 11. TUS
			MOVEQ	R0,#11
			CMP		R6,#4							;R6=4 ISE 4. COLUMN 4. ROW, 15. TUS
			MOVEQ	R0,#15
			B		FINISH
			
			
			
FINISH		CPY		R5,R0							;R0'DAKI ASIL DEGERI R5'E ALDIM CUNKU OUTCHAR R5 ISTIYOR
			LDR		R0,=GPIO_PORTB_DATA
			MOV		R1,#0
			STRB	R1,[R0,#0X03C]					;OUTPUTU 0'LIYORUM KI BASA DONDUGUMDE SORUN CIKMASIN
			BL		littledelay						;OUTPUTU DEGISTIRDIGIM ICIN BIRAZ BEKLIYORUM
			
RELEASE		LDRB	R1,[R0,#0X3FC]					;PORTB_DATA'DA SAKLANAN DEGERI R1'E YUKLUYORUM
			BL		DELAY100
			LDRB	R2,[R0,#0X3FC]					;PORTB_DATA'DA SAKLANAN DEGERI R2'YE YUKLUYORUM
			CMP		R1,R2							;DEBOUNCING
			BNE		RELEASE
			CMP		R1,#0XF0						;EGER HALA TUSA BASILI ISE BIRAKANA KADAR BEKLIYORUM, RELEASE'YE DONUYORUM
			BNE		RELEASE							;EGER TUS BIRAKILDIYSA, R1'E 0XF0 YUKLENIYOR VE BU LOOP'TAN CIKILIYOR
			
			CMP		R5,#9							;KARSILASTIRMA YAPIYORUM
			ADDHI	R5,#55							;9'DAN BUYUK ISE KARAKTER BASMAM LAZIM, 55 EKLEMELIYIM KI ASCII OLSUN
			ADDLS	R5,#48							;9'DAN KUCUK ESIT ISE RAKAM BASMAM LAZIM, 48 EKLEMELIYIM KI ASCII OLSUN
			BL		OutChar	
			B		INPUT



			ALIGN
			END