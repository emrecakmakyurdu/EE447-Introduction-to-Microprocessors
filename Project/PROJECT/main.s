THRESHOLD			EQU		0X20000400
GPIO_PORTF_RIS		EQU		0X40025414
GPIO_PORTF_ICR		EQU		0X4002541C
GPIO_PORTD_RIS		EQU		0X40007414
GPIO_PORTD_ICR		EQU		0X4000741C
TIMER1_CTL			EQU 	0x4003100C
TIMER0_CTL			EQU 	0x4003000C
TIMER5_TAILR		EQU 	0x40035028 ; Timer interval
TIMER5_CTL			EQU 	0x4003500C
FIRST_DIGIT			EQU		0X20000404
	
;LABEL			DIRECTIVE	VALUE				COMMENT	
				AREA main,	CODE,	READONLY,	ALIGN=2
				THUMB	
					
				IMPORT		DISTANCE
				IMPORT		DIST_EDGE_INIT
				IMPORT		DIST_PULSE_INIT
				IMPORT		DELAY100
				IMPORT		POT_GPIO_INIT
				IMPORT		POT_ADC_INIT
				IMPORT		SWITCH_INIT
				IMPORT		POT_ADC
				IMPORT		MOTOR_GPTM_INIT
				IMPORT		MOTOR_GPIO_INIT
				IMPORT		SCREEN_INIT
				IMPORT		SCREEN_ALWYS
				IMPORT		SCREEN_POT
				IMPORT		CLEAR4
				IMPORT		DISPLAY
				IMPORT		KEYPAD
				IMPORT		KEYPAD_INIT
				EXPORT		__main
					

MAXSPEED	EQU			0X1388
					
;PF4 SW1 10 PF0 SW2 01		SWITCHES
;GND(other) PE3 3.3V 		POT
;TIMER0A TIMER1A			TIMERS
;PF2 TRIG PB4 ECHO			DISTANCE
;PC4-5-6-7 					MOTOR
;PD0-1-2-3					KEYPAD OUTPUT ROW
;PB0-1-2-3 					KEYPAD INPUT COLUMN
;PA2-3-4-5-6-7				SCREEN

;NOKIA1 RST		PA7
;NOKIA2 CE		PA3
;NOKIA3 DC		PA6
;NOKIA4 DIN		PA5
;NOKIA5 CLK		PA2
;NOKIA6 VCC		3.3V
;NOKIA7 BL		3.3V
;NOKIA8 GND		GND	

;R8 DISTANCE VALUE
;R7 POT VALUE
;R11 MODE VALUE
					
__main			PROC
				BL		SCREEN_INIT
				BL		SCREEN_ALWYS
				BL		KEYPAD_INIT
				BL		POT_GPIO_INIT
				BL		POT_ADC_INIT
				BL		MOTOR_GPIO_INIT
				BL		MOTOR_GPTM_INIT
				BL		DIST_PULSE_INIT
				BL		DIST_EDGE_INIT
				BL		SWITCH_INIT
				
				LDR		R0,=FIRST_DIGIT
				MOV		R1,#0
				STR		R1,[R0]					;SET ALL DIGIT VALUES TO 0
				STR		R1,[R0,#4]
				STR		R1,[R0,#8]
				
				MOV		R11, #0
				LDR		R0,=THRESHOLD
				MOV		R1,#100					;INITIAL THRESHOLD VALUE AS 100
				STR		R1,[R0]
				
MAINLOOP		LDR		R1,=GPIO_PORTF_RIS		;POLL PORTF RIS
				LDR		R0,[R1]
				CMP		R0,#0X10				;IF SW1 IS PRESSED, SET R11 TO 1 IN ORDER TO GO THRESHOLD MODE
				MOVEQ	R11,#1
				CMP		R0, #0X01				;IF SW2 IS PRESSED, IGNORE IT AND RESET RIS	
				LDREQ	R1, =GPIO_PORTF_ICR
				LDREQ	R0, [R1]
				ORREQ	R0, #0X01
				STREQ	R0, [R1]

				CMP		R11,#2					;IF DISTANCE IS LOWER THAN THRESHOLD, R11 IS SET TO 2 IN NORMAL MODE
				BEQ		BREAKINGMODE
				CMP		R11,#1					;IF SW1 IS PRESSED GO INTO THRESHOLD MODE
				BEQ		THRESHOLDMODE
				CMP		R11,#0					;IF NOTHING HAPPENED, STAY ON NORMAL
				BEQ		NORMALMODE
				B		MAINLOOP
				ENDP	
					
;///////////////////////////////////////////////////////////////;	
					
NORMALMODE		PROC
				BL		DISTANCE				;MEASURE THE DISTANCE
				BL		DISPLAY					;DISPLAY ACCORDINGLY
				
				LDR		R1, =THRESHOLD			;LOAD THRESHOLD VALUE TO R0
				LDR		R1, [R1]
				LDR		R0, =MAXSPEED
				LDR		R2, =0XFFFF	
				MOV		R3, #2
				MUL		R3, R1
				CMP		R8, R3
				BHS		FULLSPEED				;IF DISTANCE IS GREATER THAN TWO TIMES THRESHOLD, DRIVE THE MOTOR AT FULLSPEED
				CMP		R8, R1					;IF DISTANCE IS LOWER THAN THRESHOLD, GO INTO BREAKING MODE
				MOVLS	R11, #2
				BLS		MAINLOOP
				
				;IF THE DISTANCE MEASUREMENT IS BETWEEN THRESHOLD AND 2*THRESHOLD, THEN MAKE SPEED CALCULATION
CALC			SUB		R8, R8, R1				;FORMULA IS SPEED = FFFF - (DISTANCE - THRESHOLD) * (FFFF - MAXSPEED) / THRESHOLD
				SUB		R3, R2, R0
				MUL		R8, R3
				UDIV	R8, R1
				SUB		R8, R2, R8
				LDR 	R1, =TIMER5_TAILR
				STR 	R8, [R1]
				B		MAINLOOP
				
FULLSPEED		LDR		R0, =MAXSPEED
				LDR 	R1, =TIMER5_TAILR
				STR		R0, [R1]		
				B		MAINLOOP
				ENDP
					
;///////////////////////////////////////////////////////////////;

THRESHOLDMODE	PROC
				LDR 	R1, =TIMER0_CTL 		; DISABLE DISTANCE MEASUREMENT
				LDR 	R2, [R1]
				BIC 	R2, R2, #0x01
				STR 	R2, [R1]		
	
				LDR 	R1, =TIMER1_CTL 		; DISABLE DISTANCE MEASUREMENT 
				LDR 	R2, [R1]
				BIC 	R2, R2, #0x01
				STR 	R2, [R1]	
	
				LDR		R1,=GPIO_PORTF_ICR		; CLEAR PORTF (TIVA SWITCH) RIS
				MOV		R0,#0X10
				STR		R0,[R1]
				LDR		R1,=GPIO_PORTD_ICR		; CLEAR KEYPAD RIS
				MOV		R0,#0X0F
				STR		R0,[R1]
				
LOOPTHR			BL		POT_ADC					;POT CALCULATION
				BL		DELAY100
				BL		DELAY100
				LDR		R0,=THRESHOLD
				STR		R7,[R0]					;REFRESH THRESHOLD VALUE ACCORDING TO THE POT.
				BL		DISPLAY					;DISPLAY ACCORDINGLY
				BL		SCREEN_POT				;DISPLAY POT. ON ROW4

				;PORTD POLL ET
				LDR		R1, =GPIO_PORTD_RIS		;IF ANY OF THE KEYS ON KEYPAD WAS PRESSED, THEN GO INTO KEYPAD MODE
				LDR		R0, [R1]
				CMP		R0,#0
				BLNE	KEYPAD
								
				LDR		R1, =GPIO_PORTF_RIS		;IF SW1 IS PRESSED, EXIT.
				LDR		R0, [R1]				;ELSE LOOP THRESHOLD
				CMP		R0, #0X10
				BEQ		EXITTHR
				CMP		R0, #0X11
				BEQ		EXITTHR
				B		LOOPTHR
				
EXITTHR			LDR		R1, =GPIO_PORTF_ICR		;CLEAR BOTH TIVA SWITCH RIS
				LDR		R0, [R1]
				ORR		R0, #0X11
				STR		R0, [R1]
				MOV		R11, #0
				BL		CLEAR4					;CLEAR ROW4 OF THE SCREEN
				LDR 	R1, =TIMER1_CTL 		;ENABLE DISTANCE MEASUREMENT
				LDR 	R2, [R1]
				ORR		R2, R2, #0x0F
				STR 	R2, [R1]				
				LDR 	R1, =TIMER0_CTL 		;ENABLE DISTANCE MEASUREMENT
				LDR 	R2, [R1]
				ORR 	R2, R2, #0x03
				STR 	R2, [R1]
				B		MAINLOOP
				
				ENDP
					
;///////////////////////////////////////////////////////////////;	
					
BREAKINGMODE	PROC
				LDR		R1,=GPIO_PORTF_ICR		;CLEAR RIS FIRST
				LDR		R0,[R1]
				ORR		R0,#0X01
				STR		R0,[R1]
				LDR 	R1, =TIMER5_CTL 		;DISABLE MOTOR
				LDR 	R2, [R1]
				BIC 	R2, R2, #0x01
				STR 	R2, [R1]					
						
LOOPBRK			BL		DISTANCE				;MAKE DISTANCE CALCULATION
				BL		DISPLAY					;DISPLAY ACCORDINGLY
				
				LDR		R1, =GPIO_PORTF_RIS		;POLL SWITCH2
				LDR		R0, [R1]
				CMP		R0, #0X01				;IF SWITCH2 WAS PRESSED, THEN EXIT
				BEQ		EXITBRK					;ELSE LOOP BREAK MODE
				CMP		R0, #0X11
				BEQ		EXITBRK
				B		LOOPBRK
				
EXITBRK			LDR		R1, =GPIO_PORTF_ICR		;CLEAR BOTH SWITCH RIS
				LDR		R0, [R1]
				ORR		R0, #0X11
				STR		R0, [R1]
				MOV		R11, #0
				LDR 	R1, =TIMER5_CTL			;ENABLE MOTOR
				LDR 	R2, [R1]
				ORR 	R2, R2, #0x03
				STR 	R2, [R1]				
				B		MAINLOOP
				
				ENDP
		
				ALIGN
				END