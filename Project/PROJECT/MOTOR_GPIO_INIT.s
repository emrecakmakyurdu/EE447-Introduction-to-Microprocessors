PC_OUT				EQU		0X400063C0

SYSCTL_RCGC2_R		EQU		0X400FE608
GPIO_PORTC_DIR_R	EQU		0X40006400
GPIO_PORTC_AFSEL_R	EQU		0X40006420
GPIO_PORTC_DEN_R	EQU		0X4000651C
GPIO_PORTC_AMSEL_R	EQU		0X40006528
GPIO_PORTC_PDR		EQU		0X40006514 ;514
GPIO_PORTC_IS		EQU		0X40006404
GPIO_PORTC_IBE		EQU		0X40006408
GPIO_PORTC_IEV		EQU		0X4000640C
GPIO_PORTC_IM		EQU		0X40006410
GPIO_PORTC_ICR		EQU		0X4000641C
GPIO_PORTC_RIS		EQU		0X40006414


;LABEL			DIRECTIVE	VALUE				COMMENT	
				AREA init_gpio,	CODE,	READONLY,	ALIGN=2
				THUMB
					
				EXPORT		MOTOR_GPIO_INIT
;C OUTPUT 4-5-6-7
			
MOTOR_GPIO_INIT	PROC
		;ACTIVATE CLOCK
				LDR		R1,=SYSCTL_RCGC2_R
				LDR		R0,[R1]
				ORR		R0,R0,#0X0C	;PORT C	
				STR		R0,[R1]
				NOP
				NOP
				NOP
		;SET DIRECTION REGISTER
				LDR		R1,=GPIO_PORTC_DIR_R
				LDR		R0,[R1]
				ORR		R0,R0,#0XF0			;1111 OUTPUT
				STR		R0,[R1]			

		;REGULAR PORT FUNCTION
				LDR		R1,=GPIO_PORTC_AFSEL_R
				LDR		R0,[R1]
				BIC		R0,R0,#0XF0
				STR		R0,[R1]			
				
		;ENABLE DIGITAL PORT
				LDR		R1,=GPIO_PORTC_DEN_R
				LDR		R0,[R1]
				ORR		R0,R0,#0XF0
				STR		R0,[R1]			

		;DISABLE ANALOG PORT
				LDR		R1,=GPIO_PORTC_AMSEL_R
				LDR		R0,[R1]
				BIC		R0,R0,#0XF0
				STR		R0,[R1]			
								
				LDR		R1,=PC_OUT
				MOV		R0,#0X20
				STR		R0,[R1]	

				BX 		LR
				ENDP
				END