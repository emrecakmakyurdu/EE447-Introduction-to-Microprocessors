PF_INP				EQU		0X40025040
PF_OUT				EQU		0X40025020
GPIO_PORTF_DIR_R	EQU		0X40025400
GPIO_PORTF_LOCK_R	EQU		0X40025520
PORTF_CR			EQU		0X40025524
GPIO_PORTF_AFSEL_R	EQU		0X40025420
GPIO_PORTF_DEN_R	EQU		0X4002551C
GPIO_PORTF_AMSEL_R	EQU		0X40025528
GPIO_PORTF_PUR		EQU		0X40025510
GPIO_PORTF_PDR		EQU		0X40025514
SYSCTL_RCGC2_R		EQU		0X400FE608
GPIO_PORTF_IS		EQU		0X40025404
GPIO_PORTF_IBE		EQU		0X40025408
GPIO_PORTF_IEV		EQU		0X4002540C
GPIO_PORTF_IM		EQU		0X40025410
GPIO_PORTF_ICR		EQU		0X4002541C
GPIO_PORTF_RIS		EQU		0X40025414

;LABEL			DIRECTIVE	VALUE				COMMENT	
				AREA init_gpio,	CODE,	READONLY,	ALIGN=2
				THUMB
					
				EXPORT		SWITCH_INIT

SWITCH_INIT	PROC
	;UNLOCK PIN F0
			LDR		R1,=GPIO_PORTF_LOCK_R
			LDR		R0,=0X4C4F434B
			STR		R0,[R1]
			LDR		R1,=PORTF_CR
			LDR		R0,[R1]
			ORR		R0,#0X01
			STR		R0,[R1]
	
	;SET DIRECTION REGISTER
			LDR		R1,=GPIO_PORTF_DIR_R
			LDR		R0,[R1]
			BIC		R0,R0,#0X11			;PF0 AND PF4 ARE INPUTS
			STR		R0,[R1]
	;REGULAR PORT FUNCTION
			LDR		R1,=GPIO_PORTF_AFSEL_R
			LDR		R0,[R1]
			BIC		R0,R0,#0X11
			STR		R0,[R1]
	;PULLUP RESISTORS ON SWITCH PINS
			LDR		R1,=GPIO_PORTF_PUR
			LDR		R0,[R1]
			ORR		R0,#0X11
			STR		R0,[R1]
	;ENABLE DIGITAL PORT
			LDR		R1,=GPIO_PORTF_DEN_R
			LDR		R0,[R1]
			ORR		R0,R0,#0X11
			STR		R0,[R1]
	;DISABLE ANALOG PORT
			LDR		R1,=GPIO_PORTF_AMSEL_R
			LDR		R0,[R1]
			BIC		R0,R0,#0X11
			STR		R0,[R1]
	;CONFIGURE INTERRUPT FOR PORTF PINS 0-3=INPUT
			LDR		R1,=GPIO_PORTF_IS
			LDR		R2,=GPIO_PORTF_IBE
			LDR		R3,=GPIO_PORTF_IEV
			LDR		R4,=GPIO_PORTF_IM
			LDR		R5,=GPIO_PORTF_ICR
			
			MOV		R0,#0X00
			STR		R0,[R1]		;edge 
			STR		R0,[R2]		;not both edge
			MOV		R0,#0X11
			STR		R0,[R3]		;rising edge
			STR		R0,[R4]		
			STR		R0,[R5]

			BX 		LR
			ENDP
			END