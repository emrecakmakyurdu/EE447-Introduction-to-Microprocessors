		AREA	keypad,	READONLY,	CODE
		THUMB
		IMPORT	SCREEN_KEY
		IMPORT	DISPLAY	
		IMPORT	KEYPAD_INIT
		IMPORT	DELAY100
		IMPORT 	littledelay
		EXPORT	KEYPAD
			
GPIO_PORTD_ICR		EQU		0X4000741C
THRESHOLD			EQU		0X20000400
FIRST_DIGIT			EQU		0X20000404
SECND_DIGIT			EQU		0X20000408
THIRD_DIGIT			EQU		0X2000040C

;INPUT IS PULLED UP
;CONNECTION IS: L1=B0,L2=B1,L3=B2,L4=B3,R1=D0,R2=D1,R3=D2,R4=D3

GPIO_PORTB_DATA		EQU		0X4000503C	;OUTPUT
GPIO_PORTD_DATA		EQU		0X4000703C	;INPUT
GPIO_PORTF_RIS		EQU		0X40025414
	
KEYPAD
			PUSH	{LR}
			BL		SCREEN_KEY						;DISPLAY KEYPAD ON ROW4
			
INPUT		LDR		R1, =GPIO_PORTF_RIS				;POLL PORTF, EXIT IF SW1 IS PRESSED
			LDR		R0, [R1]
			CMP		R0, #0X10
			BEQ.W	KEY_EXIT
			CMP		R0, #0X11
			BEQ.W	KEY_EXIT
			
			LDR		R0,=GPIO_PORTD_DATA
			LDR		R7,=GPIO_PORTB_DATA
			LDRB	R1,[R0]							
			BL		DELAY100						;DEBOUNCING
			LDRB	R2,[R0]							
			CMP		R1,R2							;COMPARISON FOR DEBOUNCING, IF SAME CONTINUE
			BNE		INPUT							
			CMP		R1,#0X0F						;EVEN THOUGH THEY ARE THE SAME, 0X0F MEANS NO KEYS WERE PRESSED, LOOP AGAIN
			BEQ		INPUT
			CPY		R5,R1							;E,D,B,7 MEANS 1. 2. 3. 4. COLUMN IN ORDER
			MOV		R6,#00							;I WILL STORE THE ROW INFO. ON R6
			MOV		R2,#01							
LOOP		STR		R2,[R7]							;OUTPUT R2
			BL		littledelay						
			LDRB	R3,[R0]							;SAVE THE INPUT
			ADD		R6,#1							;1=1.ROW, 2=2.ROW, 3=3.ROW, 4=4.ROW
			LSL		R2,#1							;SHIFT R2
			CMP		R3,#0X0F						;IF INPUT IS F, IT MEANS THIS ROW IS PRESSED
			BNE		LOOP
						
			
			;R5 INDICATES COLUM, R6 INDICATES ROW
			CMP		R5,#0X0E						;1. COLUMN
			BEQ		COL1
			CMP		R5,#0X0D						;2. COLUMN
			BEQ		COL2
			CMP		R5,#0X0B						;3. COLUMN
			BEQ		COL3
			CMP		R5,#0X07						;4. COLUMN
			BEQ		COL4

COL1		CMP		R6,#1							;R6=1 => 1. COLUMN 1. ROW, 0. BUTTON
			MOVEQ	R0,#0
			CMP		R6,#2							;R6=2 => 1. COLUMN 2. ROW, 4. BUTTON
			MOVEQ	R0,#4
			CMP		R6,#3							;R6=3 => 1. COLUMN 3. ROW, 8. BUTTON
			MOVEQ	R0,#8	
			CMP		R6,#4							;R6=4 => 1. COLUMN 4. ROW, 12. BUTTON
			MOVEQ	R0,#12
			B		FINISH
			
			
COL2		CMP		R6,#1							;R6=1 => 2. COLUMN 1. ROW, 1. BUTTON
			MOVEQ	R0,#1
			CMP		R6,#2							;R6=2 => 2. COLUMN 2. ROW, 5. BUTTON
			MOVEQ	R0,#5
			CMP		R6,#3							;R6=3 => 2. COLUMN 3. ROW, 9. BUTTON
			MOVEQ	R0,#9
			CMP		R6,#4							;R6=4 => 2. COLUMN 4. ROW, 13. BUTTON
			MOVEQ	R0,#13
			B		FINISH


COL3		CMP		R6,#1							;R6=1 => 3. COLUMN 1. ROW, 2. BUTTON
			MOVEQ	R0,#2
			CMP		R6,#2							;R6=2 => 3. COLUMN 2. ROW, 6. BUTTON
			MOVEQ	R0,#6
			CMP		R6,#3							;R6=3 => 3. COLUMN 3. ROW, 10. BUTTON
			MOVEQ	R0,#10
			CMP		R6,#4							;R6=4 => 3. COLUMN 4. ROW, 14. BUTTON
			MOVEQ	R0,#14
			B		FINISH


COL4		CMP		R6,#1							;R6=1 => 4. COLUMN 1. ROW, 3. BUTTON
			MOVEQ	R0,#3
			CMP		R6,#2							;R6=2 => 4. COLUMN 2. ROW, 7. BUTTON
			MOVEQ	R0,#7
			CMP		R6,#3							;R6=3 => 4. COLUMN 3. ROW, 11. BUTTON
			MOVEQ	R0,#11
			CMP		R6,#4							;R6=4 => 4. COLUMN 4. ROW, 15. BUTTON
			MOVEQ	R0,#15
			B		FINISH
				
			
FINISH		CPY		R5,R0
			LDR		R0,=GPIO_PORTB_DATA
			MOV		R1,#0
			STRB	R1,[R0]							;RESET THE OUTPUT
			BL		littledelay						;WAIT
			LDR		R0, =GPIO_PORTD_DATA
			
RELEASE		LDRB	R1,[R0]							;CHECK IF BUTTON IS RELEASED
			BL		DELAY100
			LDRB	R2,[R0]							;DEBOUNCING
			CMP		R1,R2							;DEBOUNCING
			BNE		RELEASE
			CMP		R1,#0X0F						;IF 0XF0, THE KEY IS RELEASED
			BNE		RELEASE							
						
			CMP		R5,#0X0F						;IF THE LAST BUTTON IS PRESSED, EXIT AND GO TO POT. MODE
			BEQ		KEY_EXIT
			
			CMP		R5,#9							;IF THE BUTTON NUMBER IS HIGHER THAN 9 BUT NOT THE LAST, IGNORE
			BHI		INPUT
			
			LDR		R0,=FIRST_DIGIT
			LDR		R1,[R0,#4]						;GET THE SECOND
			STR		R1,[R0,#8]						;PUT TO THIRD
			LDR		R1,[R0]							;GET THE FIRST
			STR		R1,[R0,#4]						;PUT TO SECOND
			STR		R5,[R0]							;PUT THE INPUT TO FIRST
			
			LDR		R1,[R0,#4]						;GET THE SECOND DIGIT, MULTIPLY BY 10 AND ACCUMULATE
			MOV		R2,#10
			MUL		R1,R2
			ADD		R5,R1
			
			LDR		R1,[R0,#8]						;GET THE THIRD DIGIT, MULTIPLY BY 100 AND ACCUMULATE
			MOV		R2,#100
			MUL		R1,R2
			ADD		R5,R1
			;R5TE THRESHOLD DEGERI VAR
			LDR		R0,=THRESHOLD	
			STR		R5,[R0]							;STORE THE NEW THRESHOLD 
			BL		DISPLAY
			
			B		INPUT
			
KEY_EXIT	LDR		R0,=GPIO_PORTD_ICR				;CLEAR THE RIS
			MOV		R1,#0X0F
			STR		R1,[R0]

			POP		{LR}
			BX		LR
		
			ALIGN
			END