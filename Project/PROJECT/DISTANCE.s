;LABEL			DIRECTIVE	VALUE				COMMENT	
				AREA distance,	CODE,	READONLY,	ALIGN=2
				THUMB				
				
				IMPORT		littledelay
				EXPORT		DISTANCE
					
TIMER1_ICR			EQU 0x40031024 ; Timer Interrupt Clear
TIMER1_RIS			EQU 0x4003101C ; Timer Interrupt Status
GPIO_PORTB_DATA		EQU 0x40005040 ; Access BIT4
GPIO_PORTB_DATA0 	EQU 0x40005004
TIMER1_TAR			EQU	0x40031048 ; Timer register
TIMER0_CTL			EQU 0x4003000C
GPIO_PORTF_ICR		EQU	0X4002541C
	
;R5 KACINCI EDGE
;R6 BIR ONCEKI TIME
;R7 HIGH = PULSE WIDTH
;R8 LOW
;R0 PERIOD
;R1 DUTY CYCLE

;pb4 echo
;pf2 trig

	
DISTANCE		PROC
				PUSH	{LR}
				MOV		R5,#0				;R5 STORES THE WHICH EDGE INFORMATION
				
LOOP			LDR		R1,=TIMER1_RIS		;POLL UNTIL EDGE IS DETECTED
				LDR		R0,[R1]
				CMP		R0,#0X04
				BNE 	LOOP
				
				LDR		R1,=TIMER1_ICR		;RESET RIS
				LDR		R0,[R1]
				ORR		R0,#0X04
				STR		R0,[R1]
			
				ADD		R5,#1
				CMP		R5,#1
				BEQ		FIRST				;FIRST EDGE
				B		SECOND				;SECOND EDGE
				
FIRST			LDR		R1,=TIMER1_TAR
				LDR		R6,[R1]				;R6 HAS THE TIME VALUE
				B		FINISH


SECOND			LDR		R1,=TIMER1_TAR
				LDR		R2,[R1]				;R2 HAS THE TIME VALUE OF OTHER EDGE
				B		POSEDGE

POSEDGE			CMP		R6,R2				;SUBTRACT THE SMALLER FROM GREATER
				SUBLO	R7,R2,R6
				SUBHI	R7,R6,R2
				B		EXIT

				
CALC			LDR		R5,=34				;CONVERT IT TO MM DISTANCE
				LDR		R6,=3200
				MUL		R7,R5
				UDIV	R7,R6
				CPY		R8,R7				;SAVE IT INTO R8
			
				MOV		R5,#0
				MOV		R6,#0
				MOV		R7,#0
				LDR 	R1, =TIMER0_CTL
				LDR 	R2, [R1]
				ORR 	R2, R2, #0x03 ; set bit0 to enable
				STR 	R2, [R1] ; and bit 1 to stall on debug					
				B		FINAL


EXIT			CMP		R5,#0X02
				BEQ		CALC
FINISH			LDR		R0,=TIMER1_ICR
				ORR		R1,#0X04			;CLEAR BIT2, BECAUSE CAPTURE MODE
				STR		R1,[R0]
				B		LOOP
				
FINAL			LDR		R0,=TIMER1_ICR
				ORR		R1,#0X04			;CLEAR BIT2, BECAUSE CAPTURE MODE
				STR		R1,[R0]
				LDR		R1,=GPIO_PORTF_ICR
				MOV		R0,#0X04
				STR		R0,[R1]							
				POP		{LR}
				BX		LR
	
				ENDP
				ALIGN
				END